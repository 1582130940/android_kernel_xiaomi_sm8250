#include <dt-bindings/gpio/gpio.h>
#include <dt-bindings/input/input.h>

#include "kona-audio-overlay.dtsi"
#include "kona-pmic-overlay.dtsi"
#include "kona-sde-display.dtsi"
#include "kona-thermal-overlay.dtsi"

#include "dsi-panel-k81-35-02-0b-video.dtsi"
#include "dsi-panel-k81-42-02-0a-video.dtsi"

&bluetooth {
        qca,bt-vdd-dig-supply = <&pm8150_s6>;
        qca,bt-vdd-dig-voltage-level = <950000 950000>;
};

&cam_cci0 {
	qcom,cam-res-mgr {
		compatible = "qcom,cam-res-mgr";
		status = "ok";
		shared-gpios = <1194 1193>;
		pinctrl-names = "cam_res_mgr_default", "cam_res_mgr_suspend";
		pinctrl-0 = <&cam_sensor_mclk0_active &cam_sensor_wide_active>;
		pinctrl-1 = <&cam_sensor_mclk0_suspend &cam_sensor_wide_suspend>;
	};

	actuator_wide: qcom,actuator@0 {
		cell-index = <0>;
		compatible = "qcom,actuator";
		cci-master = <0>;
		cam_vaf-supply = <&L4P>;
		regulator-names = "cam_vaf";
		rgltr-cntrl-support;
		rgltr-min-voltage = <2800000>;
		rgltr-max-voltage = <2800000>;
		rgltr-load-current = <100000>;
	};

	/* K81 Wide eeprom */
	eeprom_wide: qcom,eeprom@0 {
		cell-index = <0>;
		compatible = "qcom,eeprom";
		cam_vio-supply = <&pm8150a_l1>;
		regulator-names = "cam_vio";
		rgltr-cntrl-support;
		rgltr-min-voltage = <1800000>;
		rgltr-max-voltage = <1800000>;
		rgltr-load-current = <120000>;
		cci-master = <0>;
		status = "ok";
	};

	/* K81 Wide sensor ov48 & ov13 */
	qcom,cam-sensor@0 {
		cell-index = <0>;
		compatible = "qcom,cam-sensor";
		csiphy-sd-index = <1>;
		sensor-position-roll = <90>;
		sensor-position-pitch = <0>;
		sensor-position-yaw = <180>;
		actuator-src = <&actuator_wide>;
		led-flash-src = <&led_flash_wide>;
		eeprom-src = <&eeprom_wide>;
		cam_vio-supply = <&pm8150a_l1>;
		cam_vana-supply = <&L7P>;//AVDD2.8
		//cam_v_custom1-supply =<&L6P>;//AVDD1.8
		cam_vdig-supply = <&L2P>;
		cam_clk-supply = <&titan_top_gdsc>;
		regulator-names = "cam_vio", "cam_vana", "cam_vdig", "cam_clk";
		rgltr-cntrl-support;
		pwm-switch;
		rgltr-min-voltage = <1800000 2800000 1200000 0>;
		rgltr-max-voltage = <1800000 2800000 1200000 0>;
		rgltr-load-current = <120000 180000 1200000 0>;
		gpio-no-mux = <0>;
		gpios = <&tlmm 94 0>, <&tlmm 93 0>;
		gpio-reset = <1>;
		gpio-req-tbl-num = <0 1>;
		gpio-req-tbl-flags = <1 0>;
		gpio-req-tbl-label = "CAMIF_MCLK0", "CAM_RESET0";
		sensor-mode = <0>;
		cci-master = <0>;
		status = "ok";
		use-shared-clk;
		clocks = <&clock_camcc CAM_CC_MCLK0_CLK>;
		clock-names = "cam_clk";
		clock-cntl-level = "turbo";
		clock-rates = <19200000>;
	};

	/* K81 depth eeprom */
	eeprom_depth: qcom,eeprom@1 {
		cell-index = <1>;
		compatible = "qcom,eeprom";
		cam_vio-supply = <&pm8150a_l1>;
		cam_vana-supply = <&L3P>;
		cam_vdig-supply = <&pm8150a_l2>;
		cam_clk-supply = <&titan_top_gdsc>;
		regulator-names = "cam_vio", "cam_vana", "cam_vdig", "cam_clk";
		rgltr-cntrl-support;
		pwm-switch;
		rgltr-min-voltage = <1800000 2800000 1200000 0>;
		rgltr-max-voltage = <1800000 2800000 1200000 0>;
		rgltr-load-current = <120000 2000000 1200000 0>;
		gpio-no-mux = <0>;
		pinctrl-names = "cam_default", "cam_suspend";
		pinctrl-0 = <&cam_sensor_mclk1_active &cam_sensor_active_rear_depth>;
		pinctrl-1 = <&cam_sensor_mclk1_suspend &cam_sensor_suspend_rear_depth>;
		gpios = <&tlmm 95 0>,
			<&tlmm 26 0>;
		gpio-reset = <1>;
		gpio-req-tbl-num = <0 1>;
		gpio-req-tbl-flags = <1 0>;
		gpio-req-tbl-label = "CAMIF_MCLK2", "CAM_RESET2";
		sensor-mode = <0>;
		cci-master = <1>;
		status = "ok";
		clocks = <&clock_camcc CAM_CC_MCLK1_CLK>;
		clock-names = "cam_clk";
		clock-cntl-level = "turbo";
		clock-rates = <19200000>;
	};

	/* K81 Depth sensor hi556 */
	qcom,cam-sensor@1 {
		cell-index = <1>;
		compatible = "qcom,cam-sensor";
		csiphy-sd-index = <0>;
		sensor-position-roll = <90>;
		sensor-position-pitch = <0>;
		sensor-position-yaw = <180>;
		eeprom-src = <&eeprom_depth>;
		cam_vio-supply = <&pm8150a_l1>;
		cam_vana-supply = <&L3P>;
		cam_vdig-supply = <&pm8150a_l2>;
		cam_clk-supply = <&titan_top_gdsc>;
		regulator-names = "cam_vio", "cam_vana", "cam_vdig", "cam_clk";
		rgltr-cntrl-support;
		pwm-switch;
		rgltr-min-voltage = <1800000 2800000 1200000 0>;
		rgltr-max-voltage = <1800000 2800000 1200000 0>;
		rgltr-load-current = <120000 2000000 1200000 0>;
		gpio-no-mux = <0>;
		pinctrl-names = "cam_default", "cam_suspend";
		pinctrl-0 = <&cam_sensor_mclk1_active &cam_sensor_active_rear_depth>;
		pinctrl-1 = <&cam_sensor_mclk1_suspend &cam_sensor_suspend_rear_depth>;
		gpios = <&tlmm 95 0>,
			<&tlmm 26 0>;
		gpio-reset = <1>;
		gpio-req-tbl-num = <0 1>;
		gpio-req-tbl-flags = <1 0>;
		gpio-req-tbl-label = "CAMIF_MCLK2", "CAM_RESET2";
		sensor-mode = <0>;
		cci-master = <1>;
		status = "ok";
		clocks = <&clock_camcc CAM_CC_MCLK1_CLK>;
		clock-names = "cam_clk";
		clock-cntl-level = "turbo";
		clock-rates = <19200000>;
	};
};

&cam_cci1 {
	/* K81 front eeprom */
	eeprom_front: qcom,eeprom@2 {
		cell-index = <2>;
		compatible = "qcom,eeprom";
		cam_vio-supply = <&pm8150a_l1>;
		regulator-names = "cam_vio";
		rgltr-cntrl-support;
		rgltr-min-voltage = <1800000>;
		rgltr-max-voltage = <1800000>;
		rgltr-load-current = <120000>;
		cci-master = <1>;
		status = "ok";
	};

	/* K81 Front sensor ov8856 */
	qcom,cam-sensor@2 {
		cell-index = <2>;
		compatible = "qcom,cam-sensor";
		csiphy-sd-index = <4>;
		sensor-position-roll = <270>;
		sensor-position-pitch = <0>;
		sensor-position-yaw = <0>;
		eeprom-src = <&eeprom_front>;
		cam_vio-supply = <&pm8150a_l1>;
		cam_vana-supply = <&L5P>;
		cam_vdig-supply = <&L1P>;
		cam_clk-supply = <&titan_top_gdsc>;
		regulator-names = "cam_vio", "cam_vana", "cam_vdig", "cam_clk";
		rgltr-cntrl-support;
		rgltr-min-voltage = <1800000 2800000 1200000 0>;
		rgltr-max-voltage = <1800000 2800000 1200000 0>;
		rgltr-load-current = <120000 120000 120000 0>;
		gpio-no-mux = <0>;
		pinctrl-names = "cam_default", "cam_suspend";
		pinctrl-0 = <&cam_sensor_mclk3_active &cam_sensor_front_active>;
		pinctrl-1 = <&cam_sensor_mclk3_suspend &cam_sensor_front_suspend>;
		gpios = <&tlmm 97 0>, <&tlmm 109 0>;
		gpio-reset = <1>;
		gpio-req-tbl-num = <0 1>;
		gpio-req-tbl-flags = <1 0>;
		gpio-req-tbl-label = "CAMIF_MCLK3", "CAM_RESET3";
		sensor-mode = <0>;
		cci-master = <1>;
		status = "ok";
		clocks = <&clock_camcc CAM_CC_MCLK3_CLK>;
		clock-names = "cam_clk";
		clock-cntl-level = "turbo";
		clock-rates = <19200000>;
	};
};

&display_panel_avdd {
	status = "disabled";
};

&dsi_k81_35_02_0b_dual_cphy_video {
	qcom,panel-supply-entries = <&dsi_panel_pwr_supply_k81_vddio>;
	qcom,mdss-dsi-bl-pmic-control-type = "bl_ctrl_wled";
	qcom,mdss-dsi-bl-min-level = <2>;
	qcom,mdss-dsi-bl-max-level = <2047>;
	qcom,mdss-brightness-max-level = <2047>;
	qcom,mdss-brightness-init-level = <410>;
	qcom,platform-te-gpio = <&tlmm 66 0>;
	qcom,platform-reset-gpio = <&tlmm 75 0>;
	qcom,dsi-ctrl-num = <0 1>;
	qcom,dsi-phy-num = <0 1>;
	qcom,dsi-select-clocks = "mux_byte_clk0", "mux_pixel_clk0", "cphy_byte_clk0", "cphy_pixel_clk0";

	qcom,mdss-dsi-display-timings {
		timing@0 {
			qcom,mdss-dsi-panel-phy-timings = [00 00 00 00 27 2C 0A
					19 0A 02 04 00 00 00];
			qcom,display-topology = <2 0 2>;
			qcom,default-topology-index = <0>;
		};
	};
};

&dsi_k81_42_02_0a_dual_cphy_video {
	qcom,panel-supply-entries = <&dsi_panel_pwr_supply_k81_vddio>;
	qcom,mdss-dsi-bl-pmic-control-type = "bl_ctrl_wled";
	qcom,mdss-dsi-bl-min-level = <2>;
	qcom,mdss-dsi-bl-max-level = <2047>;
	qcom,mdss-brightness-max-level = <2047>;
	qcom,mdss-brightness-init-level = <410>;
	qcom,platform-te-gpio = <&tlmm 66 0>;
	qcom,platform-reset-gpio = <&tlmm 75 0>;
	qcom,dsi-ctrl-num = <0 1>;
	qcom,dsi-phy-num = <0 1>;
	qcom,dsi-select-clocks = "mux_byte_clk0", "mux_pixel_clk0", "cphy_byte_clk0", "cphy_pixel_clk0";

	qcom,mdss-dsi-display-timings {
		timing@0 {
			qcom,mdss-dsi-panel-phy-timings = [00 00 00 00 27 2C 0A
					19 0A 02 04 00 00 00];
			qcom,display-topology = <2 0 2>;
			qcom,default-topology-index = <0>;
		};
	};
};

&dsi_panel_pwr_supply_k81_vddio {
	#address-cells = <1>;
	#size-cells = <0>;

	qcom,panel-supply-entry@0 {
		reg = <0>;
		qcom,supply-name = "vddio";
		qcom,supply-min-voltage = <1880000>;
		qcom,supply-max-voltage = <1880000>;
		qcom,supply-enable-load = <62000>;
		qcom,supply-disable-load = <80>;
		qcom,supply-post-on-sleep = <10>;
		qcom,supply-post-off-sleep = <10>;
	};

	qcom,panel-supply-entry@1 {
		reg = <1>;
		qcom,supply-name = "enp";
		qcom,supply-min-voltage = <5500000>;
		qcom,supply-max-voltage = <5500000>;
		qcom,supply-enable-load = <100000>;
		qcom,supply-disable-load = <100>;
		qcom,supply-pre-on-sleep = <0>;
		qcom,supply-pre-off-sleep = <0>;
		qcom,supply-post-on-sleep = <10>;
		qcom,supply-post-off-sleep = <10>;
	};

	qcom,panel-supply-entry@2 {
		reg = <2>;
		qcom,supply-name = "enn";
		qcom,supply-min-voltage = <5500000>;
		qcom,supply-max-voltage = <5500000>;
		qcom,supply-enable-load = <100000>;
		qcom,supply-disable-load = <100>;
		qcom,supply-pre-on-sleep = <0>;
		qcom,supply-pre-off-sleep = <0>;
		qcom,supply-post-on-sleep = <10>;
		qcom,supply-post-off-sleep = <10>;
	};
};

&dsi_sim_vid {
	qcom,panel-supply-entries = <&dsi_panel_pwr_supply_vci>;
	qcom,platform-reset-gpio = <&tlmm 12 0>;
};

&disp_rdump_memory {
	compatible = "removed-dma-pool";
	no-map;
	reg = <0x0 0xb0400000 0x0 0x01000000>;
};

&firmware {
	android {
		compatible = "android,firmware";
		vbmeta {
			compatible = "android,vbmeta";
			parts = "vbmeta,boot,system,vendor,dtbo";
		};

		fstab {
			compatible = "android,fstab";
		};
	};
};

&kona_snd {
	qcom,audio-routing =
		"AMIC1", "MIC BIAS1",
		"MIC BIAS1", "Analog Mic1",
		"AMIC2", "MIC BIAS2",
		"MIC BIAS2", "Analog Mic2",
		"AMIC3", "MIC BIAS4",
		"MIC BIAS4", "Analog Mic3",
		"AMIC4", "MIC BIAS4",
		"MIC BIAS4", "Analog Mic4",
		"AMIC5", "MIC BIAS3",
		"MIC BIAS3", "Analog Mic5",
		"IN1_HPHL", "HPHL_OUT",
		"IN2_HPHR", "HPHR_OUT",
		"IN3_AUX", "AUX_OUT",
		"TX SWR_ADC0", "ADC1_OUTPUT",
		"TX SWR_ADC1", "ADC2_OUTPUT",
		"TX SWR_ADC2", "ADC3_OUTPUT",
		"TX SWR_ADC3", "ADC4_OUTPUT",
		"WSA SRC0_INP", "SRC0",
		"WSA_TX DEC0_INP", "TX DEC0 MUX",
		"WSA_TX DEC1_INP", "TX DEC1 MUX",
		"RX_TX DEC0_INP", "TX DEC0 MUX",
		"RX_TX DEC1_INP", "TX DEC1 MUX",
		"RX_TX DEC2_INP", "TX DEC2 MUX",
		"RX_TX DEC3_INP", "TX DEC3 MUX",
		"SpkrLeft IN", "WSA_SPK1 OUT",
		"SpkrRight IN", "WSA_SPK2 OUT",
		"VA_AIF1 CAP", "VA_SWR_CLK",
		"VA_AIF2 CAP", "VA_SWR_CLK",
		"VA_AIF3 CAP", "VA_SWR_CLK",
		"VA DMIC0", "VA MIC BIAS3",
		"VA DMIC1", "VA MIC BIAS3",
		"VA DMIC2", "VA MIC BIAS1",
		"VA DMIC3", "VA MIC BIAS1",
		"VA DMIC4", "VA MIC BIAS4",
		"VA DMIC5", "VA MIC BIAS4",
		"VA SWR_ADC0", "VA_SWR_CLK",
		"VA SWR_ADC1", "VA_SWR_CLK",
		"VA SWR_ADC2", "VA_SWR_CLK",
		"VA SWR_ADC3", "VA_SWR_CLK",
		"VA SWR_MIC0", "VA_SWR_CLK",
		"VA SWR_MIC1", "VA_SWR_CLK",
		"VA SWR_MIC2", "VA_SWR_CLK",
		"VA SWR_MIC3", "VA_SWR_CLK",
		"VA SWR_MIC4", "VA_SWR_CLK",
		"VA SWR_MIC5", "VA_SWR_CLK",
		"VA SWR_MIC6", "VA_SWR_CLK",
		"VA SWR_MIC7", "VA_SWR_CLK",
		"VA SWR_ADC0", "ADC1_OUTPUT",
		"VA SWR_ADC1", "ADC2_OUTPUT",
		"VA SWR_ADC2", "ADC3_OUTPUT",
		"VA SWR_ADC3", "ADC4_OUTPUT";
	qcom,ext-disp-audio-rx = <0>;
	qcom,wsa-max-devs = <0>;
	qcom,msm-mbhc-usbc-audio-supported = <1>;
	qcom,msm-mbhc-hphl-swh = <0>;
	qcom,msm-mbhc-gnd-swh = <0>;
	qcom,uart-audio-sw-gpio = <&sbu_uart_en>;
	qcom,tert-mi2s-gpios = <&tert_tdm_gpios>;
};

&L1P {
	regulator-min-microvolt = <1200000>;
	regulator-max-microvolt = <1200000>;
	qcom,min-dropout-voltage = <100000>;
};

&L2P {
	regulator-min-microvolt = <1200000>;
	regulator-max-microvolt = <1200000>;
	qcom,min-dropout-voltage = <100000>;
};

&L3P {
	regulator-min-microvolt = <2800000>;
	regulator-max-microvolt = <2800000>;
};

&L4C {
	regulator-min-microvolt = <1800000>;
	regulator-max-microvolt = <1800000>;
	qcom,init-voltage = <1800000>;
};

&L4P {
	regulator-min-microvolt = <2800000>;
	regulator-max-microvolt = <2800000>;
};

&L5P {
	regulator-min-microvolt = <2800000>;
	regulator-max-microvolt = <2800000>;
};

&L6P {
	regulator-min-microvolt = <1800000>;
	regulator-max-microvolt = <1800000>;
};

&L7P {
	regulator-min-microvolt = <2800000>;
	regulator-max-microvolt = <2900000>;
};

&L10A {
	regulator-min-microvolt = <3008000>;
	regulator-max-microvolt = <3008000>;
	qcom,init-voltage = <3008000>;
};

&nfc_enable_active {
	/* Active State */
	config {
		pins = "gpio83", "gpio110";
		drive-strength = <2>; /* 2 MA */
		bias-pull-up;
	};

	mux {
		/* 83: Enable 110: Firmware */
		pins = "gpio83", "gpio110";
		function = "gpio";
	};
};

&nfc_enable_suspend {
	/* Sleep State */
	config {
		pins = "gpio83", "gpio110";
		drive-strength = <2>; /* 2 MA */
		bias-disable;
	};

	mux {
		/* 83: Enable 110: Firmware */
		pins = "gpio83", "gpio110";
		function = "gpio";
	};
};

&pm8008_8 {
	/* PM8008 IRQ STAT */
	interrupt-parent = <&tlmm>;
	interrupts = <84 IRQ_TYPE_EDGE_RISING>;

	pinctrl-names = "default";
	pinctrl-0 = <&pm8008_active &pm8008_interrupt>;
};

&pm8008_regulators {
	vdd_l1_l2-supply = <&S8C>;
	vdd_l3_l4-supply = <&BOB>;
};

&pm8150_adc_tm {
	#address-cells = <1>;
	#size-cells = <0>;

	io-channels = <&pm8150_vadc ADC_AMUX_THM1_PU2>,
			<&pm8150_vadc ADC_AMUX_THM2_PU2>;

	/*xo_therm@4c {
		reg = <ADC_XO_THERM_PU2>;
		qcom,ratiometric;
		qcom,hw-settle-time = <200>;
	};*/

	skin_therm@4d {
		reg = <ADC_AMUX_THM1_PU2>;
		qcom,ratiometric;
		qcom,hw-settle-time = <200>;
	};

	pa_therm1@4e {
		reg = <ADC_AMUX_THM2_PU2>;
		qcom,ratiometric;
		qcom,hw-settle-time = <200>;
	};
};

&pm8150_vadc {
	#address-cells = <1>;
	#size-cells = <0>;

	vph_pwr@83 {
		reg = <ADC_VPH_PWR>;
		label = "vph_pwr";
		qcom,pre-scaling = <1 3>;
	};

	vcoin@85 {
		reg = <ADC_VCOIN>;
		label = "vcoin";
		qcom,pre-scaling = <1 3>;
	};

	xo_therm@4c {
		reg = <ADC_XO_THERM_PU2>;
		label = "xo_therm";
		qcom,ratiometric;
		qcom,hw-settle-time = <200>;
		qcom,pre-scaling = <1 1>;
	};

	skin_therm@4d {
		reg = <ADC_AMUX_THM1_PU2>;
		label = "skin_therm";
		qcom,ratiometric;
		qcom,hw-settle-time = <200>;
		qcom,pre-scaling = <1 1>;
	};

	pa_therm1@4e {
		reg = <ADC_AMUX_THM2_PU2>;
		label = "pa_therm1";
		qcom,ratiometric;
		qcom,hw-settle-time = <200>;
		qcom,pre-scaling = <1 1>;
	};
};

&pm8150a_l11 {
	qcom,init-voltage = <3000000>;
	regulator-min-microvolt = <3000000>;
	regulator-max-microvolt = <3000000>;
};

&pm8150b_pdphy {
	mi,non-qcom-pps-ctrl;
	mi,pd-power-max = <67>; /* Charge power max : 67W */
};

&pm8150b_adc_tm {
	#address-cells = <1>;
	#size-cells = <0>;

	io-channels = <&pm8150b_vadc ADC_AMUX_THM1_PU2>,
			<&pm8150b_vadc ADC_AMUX_THM3_PU2>;

	wireless_therm@4d {
		reg = <ADC_AMUX_THM1_PU2>;
		qcom,ratiometric;
		qcom,hw-settle-time = <200>;
	};

	conn_therm@4f {
		reg = <ADC_AMUX_THM3_PU2>;
		qcom,ratiometric;
		qcom,hw-settle-time = <200>;
	};
};

&pm8150b_vadc {
	#address-cells = <1>;
	#size-cells = <0>;

	vph_pwr@83 {
		reg = <ADC_VPH_PWR>;
		label = "vph_pwr";
		qcom,pre-scaling = <1 3>;
	};

	wireless_therm {
		reg = <ADC_AMUX_THM1_PU2>;
		label = "wireless_therm";
		qcom,ratiometric;
		qcom,hw-settle-time = <200>;
		qcom,pre-scaling = <1 1>;
	};

	conn_therm@4f {
		reg = <ADC_AMUX_THM3_PU2>;
		label = "conn_therm";
		qcom,ratiometric;
		qcom,hw-settle-time = <200>;
		qcom,pre-scaling = <1 1>;
	};

	chg_sbux@99 {
		reg = <ADC_SBUx>;
		label = "chg_sbux";
		qcom,pre-scaling = <1 3>;
	};

	mid_chg_div6@1e {
		reg = <ADC_MID_CHG_DIV6>;
		label = "chg_mid";
		qcom,pre-scaling = <1 6>;
	};

	usb_in_i_uv@7 {
		reg = <ADC_USB_IN_I>;
		label = "usb_in_i_uv";
		qcom,pre-scaling = <1 1>;
	};

	usb_in_v_div_16@8 {
		reg = <ADC_USB_IN_V_16>;
		label = "usb_in_v_div_16";
		qcom,pre-scaling = <1 16>;
	};
};

&pm8150l_gpios {
	pm8150l_wifi_therm {
		pm8150l_wifi_therm_default: pm8150l_wifi_therm_default {
			pins = "gpio5";
			bias-high-impedance;
		};
	};
};

&pm8150l_adc_tm {
	#address-cells = <1>;
	#size-cells = <0>;

	io-channels = <&pm8150l_vadc ADC_AMUX_THM1_PU2>,
			<&pm8150l_vadc ADC_AMUX_THM2_PU2>,
			<&pm8150l_vadc ADC_AMUX_THM3_PU2>,
			<&pm8150l_vadc ADC_GPIO1_PU2>;

	camera_flash_therm@4d {
		reg = <ADC_AMUX_THM1_PU2>;
		qcom,ratiometric;
		qcom,hw-settle-time = <200>;
	};

	skin_msm_therm@4e {
		reg = <ADC_AMUX_THM2_PU2>;
		qcom,ratiometric;
		qcom,hw-settle-time = <200>;
	};

	pa_therm2@4f {
		reg = <ADC_AMUX_THM3_PU2>;
		qcom,ratiometric;
		qcom,hw-settle-time = <200>;
	};

	wifi_therm@52 {
		reg = <ADC_GPIO1_PU2>;
		qcom,ratiometric;
		qcom,hw-settle-time = <200>;
	};
};

&pm8150l_vadc {
	#address-cells = <1>;
	#size-cells = <0>;
	pinctrl-0 = <&pm8150l_wifi_therm_default>;

	vph_pwr@83 {
		reg = <ADC_VPH_PWR>;
		label = "vph_pwr";
		qcom,pre-scaling = <1 3>;
	};

	camera_flash_therm@4d {
		reg = <ADC_AMUX_THM1_PU2>;
		label = "camera_flash_therm";
		qcom,ratiometric;
		qcom,hw-settle-time = <200>;
		qcom,pre-scaling = <1 1>;
	};

	skin_msm_therm@4e {
		reg = <ADC_AMUX_THM2_PU2>;
		label = "skin_msm_therm";
		qcom,ratiometric;
		qcom,hw-settle-time = <200>;
		qcom,pre-scaling = <1 1>;
	};

	pa_therm2@4f {
		reg = <ADC_AMUX_THM3_PU2>;
		label = "pa_therm2";
		qcom,ratiometric;
		qcom,hw-settle-time = <200>;
		qcom,pre-scaling = <1 1>;
	};

	wifi_therm@52 {
		reg = <ADC_GPIO1_PU2>;
		label = "wifi_therm";
		qcom,ratiometric;
		qcom,hw-settle-time = <200>;
		qcom,pre-scaling = <1 1>;
	};
};

&q6core {
	tert_tdm_gpios: tert_tdm_pinctl {
		compatible = "qcom,msm-cdc-pinctrl";
		pinctrl-names = "aud_active", "aud_sleep";
		pinctrl-0 = <&tert_tdm_clk_active &tert_tdm_ws_active
			&tert_tdm_din_active &tert_tdm_dout_active>;
		pinctrl-1 = <&tert_tdm_clk_sleep &tert_tdm_ws_sleep
			&tert_tdm_din_sleep &tert_tdm_dout_sleep>;
		qcom,lpi-gpios;
	};
};

&qupv3_se0_i2c {
	status = "ok";
	bq27z561_slave@55 {
		compatible = "ti,bq27z561_slave";
		reg = <0x55>;
		bq,ignore-digest-debug;
		bq,charge-full-design = <4300000>;
		bq,recharge-voltage   = <4380>;
		//bq,shutdown-delay-enable;
		bq,soc_decimal_rate = <
			0  38
			10 35
			20 33
			30 33
			40 33
			50 33
			60 33
			70 30
			80 25
			90 20
			95 10 >;
		bq,cold_thermal_seq = <
			1      0  100 1700
			2  (-300)   0 1000 >;
	};
};

&qupv3_se1_i2c {
	status = "ok";
	qcom,clk-freq-out = <1000000>;
	#address-cells = <1>;
	#size-cells = <0>;

        /* Speaker5 */
	cs35l41@40 {
		#sound-dai-cells = <1>;
		compatible = "cirrus,cs35l41";
		reset-gpios = <&tlmm 6 0>;
		reg = <0x40>;
		interrupt-parent = <&tlmm>;
		interrupts = <7 8>;
		cirrus,temp-warn_threshold = <3>;
		cirrus,boost-peak-milliamp = <4000>;
		cirrus,boost-ind-nanohenry = <1000>;
		cirrus,boost-cap-microfarad = <15>;
		cirrus,asp-sdout-hiz = <3>;
		//cirrus,right-channel-amp;
		cirrus,tuning-has-prefix;
		sound-name-prefix = "BRH";
		cirrus,fast-switch = "BRH-music.txt", "BRH-voice.txt", "BRH-voip.txt", "BRH-misc.txt";
		cirrus,gpio-config2 {
			cirrus,gpio-src-select = <0x4>;
			cirrus,gpio-output-enable;
		};

	};

        /* Speaker6 */
	cs35l41@41 {
		#sound-dai-cells = <1>;
		compatible = "cirrus,cs35l41";
		reset-gpios = <&tlmm 62 0>;
		reg = <0x41>;
		interrupt-parent = <&tlmm>;
		interrupts = <67 8>;
		cirrus,temp-warn_threshold = <3>;
		cirrus,boost-peak-milliamp = <4000>;
		cirrus,boost-ind-nanohenry = <1000>;
		cirrus,boost-cap-microfarad = <15>;
		cirrus,right-channel-amp;
		cirrus,asp-sdout-hiz = <3>;
		cirrus,tuning-has-prefix;
		sound-name-prefix = "BLH";
		cirrus,fast-switch = "BLH-music.txt", "BLH-voice.txt", "BLH-voip.txt", "BLH-misc.txt";
		cirrus,gpio-config2 {
			cirrus,gpio-src-select = <0x4>;
			cirrus,gpio-output-enable;
		};

	};

        /* Speaker7 */
	cs35l41@43 {
		#sound-dai-cells = <1>;
		compatible = "cirrus,cs35l41";
		reset-gpios = <&tlmm 49 0>;
		reg = <0x43>;
		interrupt-parent = <&tlmm>;
		interrupts = <126 8>;
		cirrus,temp-warn_threshold = <3>;
		cirrus,boost-peak-milliamp = <4000>;
		cirrus,boost-ind-nanohenry = <1000>;
		cirrus,boost-cap-microfarad = <15>;
		cirrus,asp-sdout-hiz = <3>;
		//cirrus,right-channel-amp;
		cirrus,tuning-has-prefix;
		sound-name-prefix = "BLL";
		cirrus,fast-switch = "BLL-music.txt", "BLL-voice.txt", "BLL-voip.txt", "BLL-misc.txt";
		cirrus,gpio-config2 {
			cirrus,gpio-src-select = <0x4>;
			cirrus,gpio-output-enable;
		};

	};

        /* Speaker8 */
	cs35l41@42 {
		#sound-dai-cells = <1>;
		compatible = "cirrus,cs35l41";
		reset-gpios = <&tlmm 69 0>;
		reg = <0x42>;
		interrupt-parent = <&tlmm>;
		interrupts = <100 8>;
		cirrus,temp-warn_threshold = <3>;
		cirrus,boost-peak-milliamp = <4000>;
		cirrus,boost-ind-nanohenry = <1000>;
		cirrus,boost-cap-microfarad = <15>;
		cirrus,asp-sdout-hiz = <3>;
		cirrus,tuning-has-prefix;
		sound-name-prefix = "BRL";
		cirrus,fast-switch = "BRL-music.txt", "BRL-voice.txt", "BRL-voip.txt", "BRL-misc.txt";
		cirrus,gpio-config2 {
			cirrus,gpio-src-select = <0x4>;
			cirrus,gpio-output-enable;
		};

	};

	nq@28 {
		status = "disabled";
	};
};

&qupv3_se2_spi {
	status = "disabled";
	ir-spi@0 {
		compatible = "ir-spi-led";
		reg = <0>;
		spi-max-frequency = <19200000>;
		power-supply = <&irda_regulator>;
		status = "ok";
	};
};

&qupv3_se3_i2c {
	status = "ok";

        /* Speaker1 */
	cs35l41@40 {
		#sound-dai-cells = <1>;
		compatible = "cirrus,cs35l41";
		reset-gpios = <&tlmm 50 0>;
		reg = <0x40>;
		interrupt-parent = <&tlmm>;
		interrupts = <27 8>;
		cirrus,temp-warn_threshold = <3>;
		cirrus,boost-peak-milliamp = <4000>;
		cirrus,boost-ind-nanohenry = <1000>;
		cirrus,boost-cap-microfarad = <15>;
		cirrus,asp-sdout-hiz = <3>;
		cirrus,tuning-has-prefix;
		sound-name-prefix = "TRH";
		cirrus,fast-switch = "TRH-music.txt", "TRH-voice.txt", "TRH-voip.txt", "TRH-misc.txt";
		cirrus,gpio-config2 {
			cirrus,gpio-src-select = <0x4>;
			cirrus,gpio-output-enable;
		};

	};

        /* Speaker2 */
	cs35l41@41 {
		#sound-dai-cells = <1>;
		compatible = "cirrus,cs35l41";
		reset-gpios = <&tlmm 78 0>;
		reg = <0x41>;
		interrupt-parent = <&tlmm>;
		interrupts = <92 8>;
		cirrus,temp-warn_threshold = <3>;
		cirrus,boost-peak-milliamp = <4000>;
		cirrus,boost-ind-nanohenry = <1000>;
		cirrus,boost-cap-microfarad = <15>;
		cirrus,asp-sdout-hiz = <3>;
		cirrus,tuning-has-prefix;
		sound-name-prefix = "TLH";
		cirrus,fast-switch = "TLH-music.txt", "TLH-voice.txt", "TLH-voip.txt", "TLH-misc.txt";
		cirrus,gpio-config2 {
			cirrus,gpio-src-select = <0x4>;
			cirrus,gpio-output-enable;
		};

	};

        /* Speaker3 */
	cs35l41@43 {
		#sound-dai-cells = <1>;
		compatible = "cirrus,cs35l41";
		reset-gpios = <&tlmm 144 0>;
		reg = <0x43>;
		interrupt-parent = <&tlmm>;
		interrupts = <129 8>;
		cirrus,temp-warn_threshold = <3>;
		cirrus,boost-peak-milliamp = <4000>;
		cirrus,boost-ind-nanohenry = <1000>;
		cirrus,boost-cap-microfarad = <15>;
		cirrus,asp-sdout-hiz = <3>;
		cirrus,tuning-has-prefix;
		//cirrus,right-channel-amp;
		sound-name-prefix = "TRL";
		cirrus,fast-switch = "TRL-music.txt", "TRL-voice.txt", "TRL-voip.txt", "TRL-misc.txt";
		cirrus,gpio-config2 {
			cirrus,gpio-src-select = <0x4>;
			cirrus,gpio-output-enable;
		};

	};

        /* Speaker4 */
	cs35l41@42 {
		#sound-dai-cells = <1>;
		compatible = "cirrus,cs35l41";
		reset-gpios = <&tlmm 30 0>;
		reg = <0x42>;
		interrupt-parent = <&tlmm>;
		interrupts = <112 8>;
		cirrus,temp-warn_threshold = <3>;
		cirrus,boost-peak-milliamp = <4000>;
		cirrus,boost-ind-nanohenry = <1000>;
		cirrus,boost-cap-microfarad = <15>;
		cirrus,right-channel-amp;
		cirrus,asp-sdout-hiz = <3>;
		cirrus,tuning-has-prefix;
		sound-name-prefix = "TLL";
		cirrus,fast-switch = "TLL-music.txt", "TLL-voice.txt", "TLL-voip.txt", "TLL-misc.txt";
		cirrus,gpio-config2 {
			cirrus,gpio-src-select = <0x4>;
			cirrus,gpio-output-enable;
		};

	};

};

&qupv3_se4_spi {
	status = "ok";
	qcom,rt;
	pinctrl-0 = <&qupv3_se4_spi_active>;
	pinctrl-1 = <&qupv3_se4_spi_sleep>;
	novatek@0 {
		compatible = "novatek,NVT-ts-spi";
		reg = <0>; //Same as CS ID
		status = "ok";

		spi-max-frequency = <19200000>;	//4800000,9600000,15000000,19200000
		//novatek,reset-gpio = <&tlmm 75 0x00>;
		novatek,irq-gpio = <&tlmm 39 0x2001>;

		pinctrl-0 = <&ts_cs_active>;
		pinctrl-1 = <&ts_cs_suspend>;
		pinctrl-names = "pmx_ts_active", "pmx_ts_suspend";

		novatek,pen-support;
		novatek,wgp-stylus;

		/*  523 */
		novatek,swrst-n8-addr = <0x03F0FE>;
		novatek,spi-rd-fast-addr = <0x03F310>;

		/* MP */
		novatek,mp-support-dt;

		/*new touch faeature default param*/
		novatek,touch-game-param-config1 = <2 2 1 2 1>;
		novatek,touch-game-param-config2 = <2 2 2 2 1>;
		novatek,touch-game-param-config3 = <2 2 3 2 1>;

		novatek,config-array-size = <1>;
		novatek,cfg_0 {
			novatek,display-maker = <0x42>;
			novatek,fw-name = "novatek_nt36523_k81_fw01.bin";
			novatek,mp-name = "novatek_nt36523_k81_mp01.bin";
			novatek,fw-pen-name = "novatek_nt36523_k81_fw01_pen.bin";
			novatek,mp-pen-name = "novatek_nt36523_k81_mp01_pen.bin";
		};
	};
};

&qupv3_se4_spi_active {
	mux {
		pins = "gpio8", "gpio9", "gpio10";
		function = "qup4";
	};

	config {
		pins = "gpio8", "gpio9", "gpio10";
		drive-strength = <6>;
		bias-disable;
	};
};

&qupv3_se4_spi_sleep {
	mux {
		pins = "gpio8", "gpio9", "gpio10";
		function = "gpio";
	};

	config {
		pins = "gpio8", "gpio9", "gpio10";
		drive-strength = <6>;
		bias-disable;
	};
};

&qupv3_se6_4uart {
	status = "ok";
};

&qupv3_se8_i2c {
	status = "ok";
	idtp9418: idtp9418@3b {
		compatible = "idt,p9418";
		status = "ok";
		reg = <0x3b>;
		idt,irq = <&tlmm 113 0x00>;
		hall,int3 = <&tlmm 136 0x00>;
		hall,int4 = <&tlmm 138 0x00>;
		idt,reverse-enable = <&tlmm 47 0x00>;
		idt,reverse-booset-enable = <&tlmm 22 0x00>;
		idt,wpc-det = <&tlmm 145 GPIO_ACTIVE_HIGH>;
		pinctrl-names = "idt_active", "idt_suspend";
		pinctrl-0 = <&idt_int_active &hall_intr3_active &hall_intr4_active &txon_enable_active &power_good_active &reverse_booset_enable_active>;
		pinctrl-1 = <&idt_int_suspend &hall_intr3_suspend &hall_intr4_suspend &txon_enable_suspend &power_good_suspend &reverse_booset_enable_suspend>;
	};
};

&qupv3_se11_i2c {
	status = "ok";
	aw8697_haptic@5A {
		compatible = "awinic,aw8697_haptic";
		vib_bst_vol_default = < 0x11 >;
		vib_bst_vol_ram = < 0x11 >;
		vib_bst_vol_rtp = < 0x11 >;
		status = "disabled";
	};

	ktz8866@11 {
		compatible = "ktz,ktz8866";
		status = "ok";
		reg = <0x11>;
		ktz8866,hwen-gpio = <&tlmm 139 0x00>;
		ktz8866,enp-gpio = <&tlmm 130 0x00>;
		ktz8866,enn-gpio = <&tlmm 131 0x00>;
		ktz8866,panelid-gpio = <&tlmm 38 0x00>;
	};
};

&qupv3_se12_2uart {
	status = "ok";
};

&qupv3_se13_i2c {
	status = "ok";
	bq27z561_master@55 {
		compatible = "ti,bq27z561_master";
		reg = <0x55>;
		bq,ignore-digest-debug;
		bq,charge-full-design = <4300000>;
		bq,recharge-voltage   = <4380>;
		//bq,shutdown-delay-enable;
		bq,force-soc-enable;
		bq,soc_decimal_rate = <
			0  38
			10 35
			20 33
			30 33
			40 33
			50 33
			60 33
			70 30
			80 25
			90 20
			95 10 >;
		bq,cold_thermal_seq = <
			1      0  100 1700
			2  (-300)   0 1000 >;
	};
};

&qupv3_se15_i2c {
	status = "ok";
	#address-cells = <1>;
	#size-cells = <0>;
	#include "pm8008.dtsi"
	#include "smb1390.dtsi"

	bq25970-master@65 {
		compatible = "ti,bq2597x-master";
		reg = <0x65>;
		interrupt-parent = <&tlmm>;
		interrupts = <68 0x2002>;
		pinctrl-names = "default";
		pinctrl-0 = <&bq2597x_master_int_default>;

		ti,bq2597x,bat-ovp-alarm-disable;
		ti,bq2597x,bat-ocp-disable;
		ti,bq2597x,bat-ocp-alarm-disable;
		ti,bq2597x,bat-ucp-alarm-disable;
		ti,bq2597x,bat-ucp-disable;

		ti,bq2597x,bat-therm-disable;
		ti,bq2597x,bus-therm-disable;
		ti,bq2597x,die-therm-disable;

		ti,bq2597x,bat-ovp-threshold = <4550>;
		ti,bq2597x,bat-ovp-alarm-threshold = <4525>;

		ti,bq2597x,bus-ovp-threshold = <12000>;
		ti,bq2597x,bus-ovp-alarm-threshold = <11000>;
		ti,bq2597x,bus-ocp-threshold = <3800>;
		ti,bq2597x,bus-ocp-alarm-threshold = <3500>;

		ti,bq2597x,bat-therm-threshold = <0x15>; /* 4.1% */
		ti,bq2597x,bus-therm-threshold = <0x15>; /* 4.1% */
		ti,bq2597x,die-therm-threshold = <145>;

		ti,bq2597x,ac-ovp-threshold = <14>;

		sc8551,ac-ovp-threshold = <14>;
	};

	bq25970-slave@66 {
		compatible = "ti,bq2597x-slave";
		reg = <0x66>;

		ti,bq2597x,bat-ovp-alarm-disable;
		ti,bq2597x,bat-ocp-disable;
		ti,bq2597x,bat-ocp-alarm-disable;
		ti,bq2597x,bat-ucp-alarm-disable;

		ti,bq2597x,bat-ucp-disable;

		ti,bq2597x,bat-therm-disable;
		ti,bq2597x,bus-therm-disable;
		ti,bq2597x,die-therm-disable;

		ti,bq2597x,bat-ovp-threshold = <4550>;
		ti,bq2597x,bat-ovp-alarm-threshold = <4525>;

		ti,bq2597x,bus-ovp-threshold = <12000>;
		ti,bq2597x,bus-ovp-alarm-threshold = <11000>;
		ti,bq2597x,bus-ocp-threshold = <3500>;
		ti,bq2597x,bus-ocp-alarm-threshold = <3000>;

		ti,bq2597x,bat-therm-threshold = <0x15>; /* 4.1% */
		ti,bq2597x,bus-therm-threshold = <0x15>; /* 4.1% */
		ti,bq2597x,die-therm-threshold = <125>;

		ti,bq2597x,ac-ovp-threshold = <14>;

		sc8551,ac-ovp-threshold = <13>;
	};

	halo,hl6111r@25 {
		compatible = "halo,hl6111r";
		reg = <0x25>;
		status = "disabled";
	};

	nq@64 {
		status = "disabled";
	};
};

&pcie1 {
	status = "disabled";
};

&pcie1_msi {
	status = "disabled";
};

&pm8150a_amoled {
	status = "disabled";
};

&pm8150b_charger {
	status = "ok";
	qcom,sec-charger-config = <0>;
	qcom,usb-icl-ua = <6200000>;
	qcom,fcc-max-ua = <12400000>;
	qcom,fv-max-uv = <4500000>;
	qcom,non-fcc-fv-max-uv = <4450000>;
	qcom,dc-icl-ua = <1000000>;
	qcom,auto-recharge-vbat-mv = <4400000>;
	qcom,chg-term-src = <1>;
	qcom,chg-term-current-ma = <(-180)>;
	qcom,step-charging-enable;
	qcom,sw-jeita-enable;
	qcom,chg-warm-th= <480>;
	qcom,chg-cool-th= <150>;
	qcom,usbpd-phandle = <&pm8150b_pdphy>;
	qcom,battery-data = <&enuma_batterydata>;
	mi,support-ffc;
	qcom,lpd-disable;
	mi,use-bq-pump;
	qcom,support-ext-fg;
	qcom,support-wireless;
	mi,support-second-ffc-term-current;
	mi,support-second-ffc-term-current-diff = <130>;
	mi,support-qc3p5-without-smb;
	qcom,disable-suspend-on-collapse;
	qcom,distinguish-qc-class-ab;
	qcom,support-conn-therm;
	vbus-disable-gpio = <&tlmm 74 GPIO_ACTIVE_HIGH>;
	pinctrl-names = "default", "vbus_disable_active", "vbus_disable_suspend";
	pinctrl-0 = <&vbus_disable_suspend>;
	pinctrl-1 = <&vbus_disable_active>;
	pinctrl-2 = <&vbus_disable_suspend>;

	io-channels = <&pm8150b_vadc ADC_USB_IN_V_16>,
			<&pm8150b_vadc ADC_MID_CHG_DIV6>,
			<&pm8150b_vadc ADC_USB_IN_I>,
			<&pm8150b_vadc ADC_SBUx>,
			<&pm8150b_vadc ADC_VPH_PWR>,
			<&pm8150b_vadc ADC_AMUX_THM3_PU2>,
			<&pm8150b_vadc ADC_CHG_TEMP>;
	io-channel-names = "usb_in_voltage",
			"mid_voltage",
			"usb_in_current",
			"sbux_res",
			"vph_voltage",
			"conn_temp",
			"chg_temp";
	qcom,thermal-mitigation = <3000000 2800000 2600000 2400000 2200000 2100000 2000000
				   1800000 1600000 1500000 1400000 1200000 1000000 900000
				   800000 500000>;
	qcom,thermal-mitigation-icl
				= <2800000 2700000 2600000 2400000 2200000 2100000 2000000
				   1800000 1600000 1500000 1400000 1300000 1200000 1100000
				   950000 750000>;
	qcom,thermal-mitigation-dcp
				= <1800000 1800000 1800000 1800000 1800000 1800000 1800000
				   1800000 1800000 1700000 1600000 1400000 1200000 1100000
				   1100000 1000000>;
	qcom,thermal-mitigation-qc2
				= <1500000 1500000 1500000 1500000 1450000 1400000 1350000
				   1300000 1150000 1100000 1000000 900000 850000 750000
				   650000 500000>;
	qcom,thermal-fcc-qc3-normal
				= <3200000 3000000 2800000 2600000 2500000 2400000 2300000
				   2200000 2100000 1800000 1600000 1400000 1200000 1000000
				   750000 750000>;
	qcom,thermal-fcc-qc3-cp
				= <4800000 4600000 4400000 4200000 4000000 3800000 3600000
				   3400000 3000000 2600000 2400000 2200000 2000000 1300000
				   1000000 700000>;
	qcom,thermal-fcc-qc3-classb-cp
				= <5100000 4700000 4300000 4000000 3600000 3500000 3400000
				   3400000 3400000 3200000 2500000 2200000 2000000 700000
				   300000 100000>;
	qcom,thermal-mitigation-pd-base
				= <3000000 2800000 2600000 2400000 2200000 2000000 1800000
				   1600000 1600000 1400000 1200000 1100000 1050000 1000000
				   950000 500000>;
	qcom,thermal-fcc-pps-bq
				= <12400000 10000000 8800000 8000000 7000000 6000000 5600000
				   5000000 4000000 3000000 2500000 2000000 1400000 1000000
				   700000 300000>;
};

&pm8150b_fg {
	status = "disabled";
};

&pm8150b_haptics {
	vdd-supply = <&vreg_hap_boost>;
};

&pm8150l_lcdb {
	status = "disabled";
};

&pm8150l_wled {
	status = "disabled";
	qcom,string-cfg = <7>;
};

&pmx_ts_release {
	mux {
		pins = "gpio33", "gpio39";
		function = "gpio";
	};

	config {
		pins = "gpio33", "gpio39";
		drive-strength = <2>;
		bias-disable;
	};
};

&sde_dp {
	status = "disabled";
};

&sde_dsi {
	/delete-property/ avdd-supply;
	/delete-property/ vdd-supply;
	enn-supply = <&display_panel_enn>;
	enp-supply = <&display_panel_enp>;
	qcom,dsi-default-panel = <&dsi_k81_42_02_0a_dual_cphy_video>;
};

&sde_dsi_active {
	config {
		pins = "gpio75";
		drive-strength = <8>; /* 8 mA */
		bias-disable = <0>; /* No Pull */
	};

	mux {
		pins = "gpio75";
		function = "gpio";
	};
};

&sde_dsi_suspend {
	config {
		pins = "gpio75";
		drive-strength = <2>; /* 2 mA */
		bias-pull-down; /* Pull Down */
	};

	mux {
		pins = "gpio75";
		function = "gpio";
	};
};

&sdhc_2 {
	status = "disabled";
};

&smb1390 {
	status = "disabled";
};

&smb1390_charger {
	status = "disabled";
};

&smb1390_slave {
	status = "ok";
};

&smb1390_slave_charger {
	status = "ok";
};

&soc {
	cp_qc30 {
		compatible = "xiaomi,cp-qc30";
		status = "ok";
		mi,qc3-bat-volt-max = <4420>;
		mi,qc3-bat-curr-max = <3600>;
		mi,qc3-bus-volt-max = <12000>;
		mi,qc3-bus-curr-max = <2100>;
		mi,qc3-battery-warm-th = <480>;
		mi,support-qc3p5-without-smb;
		mi,cp-sec-enable;
		mi,chg-enable-k81;
	};

	display_panel_enn: display_gpio_regulator_enn {
		compatible = "regulator-fixed";
		regulator-name = "display_panel_enn";
		regulator-min-microvolt = <5500000>;
		regulator-max-microvolt = <5500000>;
		regulator-enable-ramp-delay = <233>;
		gpio = <&tlmm 131 0>;
		enable-active-high;
		regulator-boot-on;
		pinctrl-names = "default";
		pinctrl-0 = <&display_panel_enn_default>;
	};

	display_panel_enp: display_gpio_regulator_enp {
		compatible = "regulator-fixed";
		regulator-name = "display_panel_enp";
		regulator-min-microvolt = <5500000>;
		regulator-max-microvolt = <5500000>;
		regulator-enable-ramp-delay = <233>;
		gpio = <&tlmm 130 0>;
		enable-active-high;
		regulator-boot-on;
		pinctrl-names = "default";
		pinctrl-0 = <&display_panel_enp_default>;
	};

	dual-FuelGauge{
		compatible = "xiaomi,dual-FuelGauge";
		bq,ignore-digest-debug;
		bq,shutdown-delay-enable;
		bq,recharge-voltage = <4380>;
		bq,soc_decimal_rate = <
			0  38
			10 35
			20 33
			30 33
			40 33
			50 33
			60 33
			70 30
			80 25
			90 20
			95 10 >;
		fg-master-disable-gpio = <&tlmm 117 GPIO_ACTIVE_HIGH>;
		fg-slave-disable-gpio = <&tlmm 91 GPIO_ACTIVE_HIGH>;
	};

	enuma_batterydata: qcom,battery-data {
		qcom,batt-id-range-pct = <15>;
		/* j1 jeita, step charge and other important charging parameters */
		qcom,fastchg-current-ma = <12400>;
		qcom,jeita-fcc-ranges = <(-100)  0   810000
					1  50   1680000
					51  100  4200000
					101 150  6720000
					151 480  12400000
					481 580  4200000>;
		qcom,jeita-fv-ranges = <(-100)  0   4450000
					1   50   4450000
					51  100  4450000
					101 150  4450000
					151 480  4500000
					481 580  4100000>;
		qcom,step-chg-ranges = <3000000  3349000  1000000
					3350000  4199000  12400000
					4200000  4449000  10800000
					4450000  4500000  6720000>;
		qcom,cold-step-chg-ranges = <3000000  4199000  1000000
					4200000  4450000  660000>;
		qcom,jeita-too-hot = <580>;
		qcom,jeita-too-cold = <(-100)>;
		qcom,jeita-warm-th= <480>;
		qcom,jeita-cool-th= <150>;
		qcom,ocv-based-step-chg;
		qcom,use-bq-pump;
		qcom,use-ext-gauge;
		qcom,max-voltage-uv = <4500000>;
		qcom,batt-id-kohm = <100>;
		qcom,battery-type = "k81_profile";
	};

	ext_5v_boost: ext_5v_boost {
		compatible = "regulator-fixed";
		status = "disabled";
		regulator-name = "ext_5v_boost";
		gpio = <&pm8150b_gpios 12 GPIO_ACTIVE_HIGH>;
		enable-active-high;
		regulator-enable-ramp-delay = <1600>;

		pinctrl-names = "default";
		pinctrl-0 = <&otg_vbus_boost_default>;
	};

	fingerprint_fpc {
		status = "ok";
		compatible = "fpc,fpc1020";
		interrupt-parent = <&tlmm>;
		interrupts = <23 0x0>;
		fpc,gpio_rst    = <&tlmm 125 0x0>;
		fpc,gpio_irq    = <&tlmm 23 0x0>;
		fp_vdd_vreg-supply = <&L4C>;
		pinctrl-names = "fpc1020_reset_reset",
			"fpc1020_reset_active",
			"fpc1020_irq_active";

		pinctrl-0 = <&msm_gpio_reset>;
		pinctrl-1 = <&msm_gpio_reset_output_high>;
		pinctrl-2 = <&msm_gpio_irq>;

	};

	fingerprint_goodix {
		compatible = "goodix,fingerprint";
		goodix,gpio-reset = <&tlmm 125 GPIO_ACTIVE_LOW>;
		goodix,gpio-irq = <&tlmm 23 GPIO_ACTIVE_HIGH>;
		fp_vdd_vreg-supply = <&L10A>;
		status = "ok";
	};

	gpio_keys {
		compatible = "gpio-keys";
		label = "gpio-keys";

		pinctrl-names = "default";
		pinctrl-0 = <&key_vol_up_default>;
		hall_key {
			label = "hall_key";
			gpios = <&tlmm 110 GPIO_ACTIVE_LOW>;
			linux,input-type = <5>;
			linux,code = <0>;
			gpio-key,wakeup;
			debounce-interval = <15>;
		};

		hall_key1 {
			label = "hall_key1";
			gpios = <&tlmm 121 GPIO_ACTIVE_LOW>;
			linux,input-type = <5>;
			linux,code = <1>;
			gpio-key,wakeup;
			debounce-interval = <15>;
		};

		vol_up {
			label = "volume_up";
			gpios = <&pm8150_gpios 6 GPIO_ACTIVE_LOW>;
			linux,input-type = <1>;
			linux,code = <KEY_VOLUMEUP>;
			gpio-key,wakeup;
			debounce-interval = <15>;
			linux,can-disable;
		};
	};

	irda_regulator: irda-regulator {
		compatible = "regulator-dummy";
		regulator-name = "irda_regulator";
	};

	led_flash_wide: qcom,camera-flash@0 {
		cell-index = <0>;
		compatible = "qcom,camera-flash";
		flash-source = <&pm8150l_flash0>;
		torch-source = <&pm8150l_torch0>;
		switch-source = <&pm8150l_switch0>;
		status = "ok";
	};

	led_flash_ultra_wide: qcom,camera-flash@1 {
		cell-index = <1>;
		compatible = "qcom,camera-flash";
		flash-source = <&pm8150l_flash0>;
		torch-source = <&pm8150l_torch0>;
		switch-source = <&pm8150l_switch0>;
		status = "ok";
	};

	led_flash_macro: qcom,camera-flash@2 {
		cell-index = <2>;
		compatible = "qcom,camera-flash";
		flash-source = <&pm8150l_flash0>;
		torch-source = <&pm8150l_torch0>;
		switch-source = <&pm8150l_switch0>;
		status = "ok";
	};

	md_testing_mode {
		compatible = "modem,md-testing-mode";
		status-gpio = <&tlmm 111 0x00>;
		debounce-time = <30>;
		pinctrl-names = "default";
		pinctrl-0 = <&ant1_ctrl_irq>;
	};

	msm_notifier: qcom,msm_notifier@0 {
		panel = <&dsi_k81_35_02_0b_dual_cphy_video
			&dsi_k81_42_02_0a_dual_cphy_video>;
	};

	qcom,qbt_handler {
		compatible = "qcom,qbt-handler";
		qcom,ipc-gpio = <&tlmm 23 0>;
		pinctrl-names = "default";
		pinctrl-0 = <&key_home_default>;
		qcom,finger-detect-gpio = <&pm8150_gpios 1 0>;
		status = "disabled";
	};

	testing_mode {
		compatible = "xiaomi,testing-mode";
		status-gpio = <&tlmm 70 0x00>;
		debounce-time = <30>;
		pinctrl-names = "default";
		pinctrl-0 = <&test_mode_irq>;
	};

	thermal_message: thermal-message {
		board-sensor = "VIRTUAL-SENSOR";
		ambient-sensor = "ABT-SENSOR";
	};

	touch_vddio_vreg: touch_vddio_vreg {
		status = "disabled";
	 };

	sbu_uart_en: msm_cdc_pinctrl@159 {
		compatible = "qcom,msm-cdc-pinctrl";
		pinctrl-names = "aud_active", "aud_sleep";
		pinctrl-0 = <&sbu_uart_en_active>;
		pinctrl-1 = <&sbu_uart_en_idle>;
	};

	usbpd_pm {
		compatible = "xiaomi,usbpd-pm";
		status = "ok";
		mi,pd-bat-volt-max = <4480>;
		mi,pd-bat-curr-max = <12400>;
		mi,pd-bus-volt-max = <12000>;
		mi,pd-bus-curr-max = <6200>;
		mi,pd-bus-curr-compensate  = <50>;
		mi,pd-non-ffc-bat-volt-max = <4450>;
		mi,pd-battery-warm-th = <480>;
		mi,cp-sec-enable;
		mi,therm-level-threshold = <12>;
		mi,step-charge-high-vol-curr-max = <6720>;
		mi,cell-vol-high-threshold-mv = <4450>;
		mi,cell-vol-max-threshold-mv = <4487>;
		mi,chg-enable-k81;
		mi,pd-power-max = <67>; /*charge power max : 67W */
	};

	vdd_boost_vreg: vdd_boost_vreg {
		compatible = "regulator-fixed";
		regulator-name = "vdd_boost_vreg";
		startup-delay-us = <4000>;
		enable-active-high;
		regulator-always-on;
		gpio = <&pm8150b_gpios 5 0>;
	 };

	xiaomi_keyboard {
		compatible = "xiaomi,keyboard";
		pinctrl-names = "pm_kb_active", "pm_kb_suspend";
		pinctrl-0 = <&xiaomi_keyboard_active>;
		pinctrl-1 = <&xiaomi_keyboard_suspend>;
		xiaomi-keyboard,rst-gpio = <&tlmm 141 0x00>;
		xiaomi-keyboard,in-irq-gpio = <&tlmm 83 0x2001>;
		xiaomi-keyboard,vdd-gpio = <&tlmm 127 0x00>;
		status = "ok";
	};

	xiaomi_touch {
		compatible = "xiaomi-touch";
		status = "ok";
		touch,name = "xiaomi-touch";
	};
};

&spmi_debug_bus {
	status = "ok";
};

&thermal_zones {
	charger_therm0 {//place close to charge IC
		polling-delay-passive = <0>;
		polling-delay = <0>;
		thermal-governor = "user_space";
		thermal-sensors = <&pm8150b_adc_tm ADC_AMUX_THM1_PU2>;
		trips {
			active-config0 {
				temperature = <125000>;
				hysteresis = <1000>;
				type = "passive";
			};
		};
	};

	conn_therm {//place close to type-c connector
		polling-delay-passive = <0>;
		polling-delay = <0>;
		thermal-governor = "user_space";
		thermal-sensors = <&pm8150b_adc_tm ADC_AMUX_THM3_PU2>;
		wake-capable-sensor;
		trips {
			active-config0 {
				temperature = <125000>;
				hysteresis = <1000>;
				type = "passive";
			};
		};
	};

	cpu_therm {//place close to sm8250
		polling-delay-passive = <0>;
		polling-delay = <0>;
		thermal-governor = "user_space";
		thermal-sensors = <&pm8150_adc_tm ADC_AMUX_THM1_PU2>;
		wake-capable-sensor;
		trips {
			active-config0 {
				temperature = <125000>;
				hysteresis = <1000>;
				type = "passive";
			};
		};
	};

	quiet_therm {//place close to cool place
		polling-delay-passive = <0>;
		polling-delay = <0>;
		thermal-governor = "user_space";
		thermal-sensors = <&pm8150_adc_tm ADC_AMUX_THM2_PU2>;
		wake-capable-sensor;
		trips {
			active-config0 {
				temperature = <125000>;
				hysteresis = <1000>;
				type = "passive";
			};
		};
	};

	pa_therm1 {//place close to pa1
		polling-delay-passive = <0>;
		polling-delay = <0>;
		thermal-governor = "user_space";
		thermal-sensors = <&pm8150l_adc_tm ADC_AMUX_THM1_PU2>;
		wake-capable-sensor;
		trips {
			active-config0 {
				temperature = <125000>;
				hysteresis = <1000>;
				type = "passive";
			};
		};
	};

	pa_therm0 {//place close to pa0
		polling-delay-passive = <0>;
		polling-delay = <0>;
		thermal-governor = "user_space";
		thermal-sensors = <&pm8150l_adc_tm ADC_AMUX_THM2_PU2>;
		wake-capable-sensor;
		trips {
			active-config0 {
				temperature = <125000>;
				hysteresis = <1000>;
				type = "passive";
			};
		};
	};

	backlight_therm {
		polling-delay-passive = <0>;
		polling-delay = <0>;
		thermal-governor = "user_space";
		thermal-sensors = <&pm8150l_adc_tm ADC_AMUX_THM3_PU2>;
		wake-capable-sensor;
		trips {
			active-config0 {
				temperature = <125000>;
				hysteresis = <1000>;
				type = "passive";
			};
		};
	};

	flash_therm {//place close to flash
		polling-delay-passive = <0>;
		polling-delay = <0>;
		thermal-governor = "user_space";
		thermal-sensors = <&pm8150l_adc_tm ADC_GPIO1_PU2>;
		wake-capable-sensor;
		trips {
			active-config0 {
				temperature = <125000>;
				hysteresis = <1000>;
				type = "passive";
			};
		};
	};
};

/* IC int pin, rst pin init */
&tlmm {
	bq2597x {
		bq2597x_master_int_default: bq2597x_master_int_default {
			/* Active State */
			mux {
				/* GPIO 68 is used for bq25970 master ic interrupt usage */
				pins = "gpio68";
				function = "gpio";
			};

			config {
				pins = "gpio68";
				drive-strength = <2>; /* 2 MA */
				bias-pull-up;
				input-enable;
			};
		};

		bq2597x_master_int_suspend: bq2597x_master_int_suspend {
			/* Sleep State */
			mux {
				/* GPIO 83 is used for bq25970 master ic interrupt usage */
				pins = "gpio68";
				function = "gpio";
			};

			config {
				pins = "gpio68";
				drive-strength = <2>; /* 2 MA */
				bias-pull-up;
				input-enable;
			};
		};

		bq2597x_slave_int_default: bq2597x_slave_int_default {
			/* Active State */
			mux {
				/* GPIO 64 is used for bq25970 slave ic interrupt usage */
				pins = "gpio64";
				function = "gpio";
			};

			config {
				pins = "gpio64";
				drive-strength = <2>;
				bias-pull-down;
				output-low;
			};
		};
	};

	cam_sensor_mclk1_active: cam_sensor_mclk1_active {
		/* MCLK1 */
		mux {
			pins = "gpio95";
			function = "cam_mclk";
		};

		config {
			pins = "gpio95";
			bias-disable; /* No PULL */
			drive-strength = <4>; /* 4 MA */
		};
	};

	cam_sensor_mclk1_suspend: cam_sensor_mclk1_suspend {
		/* MCLK1 */
		mux {
			pins = "gpio95";
			function = "cam_mclk";
		};

		config {
			pins = "gpio95";
			bias-pull-down; /* PULL DOWN */
			drive-strength = <4>; /* 4 MA */
		};
	};

	cam_sensor_active_rear_depth:cam_sensor_active_rear_depth {
		/* RESET DEPTH */
		mux {
			pins = "gpio26";
			function = "gpio";
		};

		config {
			pins = "gpio26";
			bias-disable; /* No PULL */
			drive-strength = <2>; /* 2 MA */
		};
	};

	cam_sensor_suspend_rear_depth:cam_sensor_suspend_rear_depth {
		mux {
			pins = "gpio26";
			function = "gpio";
		};

		config {
			pins = "gpio26";
			bias-pull-down; /* PULL DOWN */
			drive-strength = <2>; /* 2 MA */
			output-low;
		};
	};

	cam_sensor_wide_active: cam_sensor_wide_active {
		/* RESET WIDE */
		mux {
			pins = "gpio93";
			function = "gpio";
		};

		config {
			pins = "gpio93";
			bias-disable; /* No PULL */
			drive-strength = <2>; /* 2 MA */
		};
	};

	cam_sensor_wide_suspend: cam_sensor_wide_suspend {
		mux {
			pins = "gpio93";
			function = "gpio";
		};

		config {
			pins = "gpio93";
			bias-pull-down; /* PULL DOWN */
			drive-strength = <2>; /* 2 MA */
			output-low;
		};
	};

	cam_sensor_front_active: cam_sensor_front_active {
		/* RESET FRONT */
		mux {
			pins = "gpio109";
			function = "gpio";
		};

		config {
			pins = "gpio109";
			bias-disable; /* No PULL */
			drive-strength = <2>; /* 2 MA */
		};
	};

	cam_sensor_front_suspend: cam_sensor_front_suspend {
		mux {
			pins = "gpio109";
			function = "gpio";
		};

		config {
			pins = "gpio109";
			bias-pull-down; /* PULL DOWN */
			drive-strength = <2>; /* 2 MA */
			output-low;
		};
	};

	cam_sensor_rear_ultra_active: cam_sensor_rear_ultra_active {
		/* RESET REAR ULTRA */
		mux {
			pins = "gpio78";
			function = "gpio";
		};

		config {
			pins = "gpio78";
			bias-disable; /* No PULL */
			drive-strength = <2>; /* 2 MA */
		};
	};

	cam_sensor_rear_ultra_suspend: cam_sensor_rear_ultra_suspend {
		mux {
			pins = "gpio78";
			function = "gpio";
		};

		config {
			pins = "gpio78";
			bias-pull-down; /* PULL DOWN */
			drive-strength = <2>; /* 2 MA */
			output-low;
		};
	};

	cam_sensor_macro_active: cam_sensor_macro_active {
		/* RESET MACRO */
		mux {
			pins = "gpio92";
			function = "gpio";
		};

		config {
			pins = "gpio92";
			bias-disable; /* No PULL */
			drive-strength = <2>; /* 2 MA */
		};
	};

	cam_sensor_macro_suspend: cam_sensor_macro_suspend {
		mux {
			pins = "gpio92";
			function = "gpio";
		};

		config {
			pins = "gpio92";
			bias-pull-down; /* PULL DOWN */
			drive-strength = <2>; /* 2 MA */
			output-low;
		};
	};

	dc_chg_enable {
		dc_en_active: dc_en_active {
			/* Active State */
			mux {
				/* GPIO 82 is used for wireless charge enable bq by output vol to bq vac */
				pins = "gpio82";
				function = "gpio";
			};

			config {
				pins = "gpio82";
				bias-disable; /* No PULL */
				drive-strength = <16>; /* 16 MA */
				output-low;
			};
		};

		dc_en_suspend: dc_en_suspend {
			/* Sleep State */
			mux {
				pins = "gpio82";
				function = "gpio";
			};

			config {
				pins = "gpio82";
				drive-strength = <16>; /* 16 MA */
				bias-disable;
				output-low;
			};
		};
	};


	/* GPIO_131 : display_panel_enn -5V */
	display_panel_enn_default: display_panel_enn_default {
		mux {
			pins = "gpio131";
			function = "gpio";
		};

		config {
			pins = "gpio131";
			drive-strength = <8>;
			bias-disable = <0>;
			output-high;
		};
	};

	/* GPIO_130 : display_panel_enp +5V */
	display_panel_enp_default: display_panel_enp_default {
		mux {
			pins = "gpio130";
			function = "gpio";
		};

		config {
			pins = "gpio130";
			drive-strength = <8>;
			bias-disable = <0>;
			output-high;
		};
	};

	hall {
		hall_intr3_active: hall_intr3_active {
			/* Active State */
			mux {
				pins = "gpio136";
				function = "gpio";
			};

			config {
				pins = "gpio136";
				drive-strength = <2>; /* 2 MA */
				bias-pull-up;
				input-enable;
			};
		};

		hall_intr3_suspend: hall_intr3_suspend {
			/* Sleep State */
			mux {
				pins = "gpio136";
				function = "gpio";
			};

			config {
				pins = "gpio136";
				drive-strength = <2>; /* 2 MA */
				bias-pull-up;
				input-enable;
			};
		};

		hall_intr4_active: hall_intr4_active {
			/* Active State */
			mux {
				pins = "gpio138";
				function = "gpio";
			};

			config {
				pins = "gpio138";
				drive-strength = <2>; /* 2 MA */
				bias-pull-up;
				input-enable;
			};
		};

		hall_intr4_suspend: hall_intr4_suspend {
			/* Sleep State */
			mux {
				pins = "gpio138";
				function = "gpio";
			};

			config {
				pins = "gpio138";
				drive-strength = <2>; /* 2 MA */
				bias-pull-up;
				input-enable;
			};
		};
	};

	idt {
		idt_int_active: idt_int_active {
			/* Active State */
			mux {
				pins = "gpio113";
				function = "gpio";
			};

			config {
				pins = "gpio113";
				drive-strength = <2>; /* 2 MA */
				bias-pull-up;
				input-enable;
			};
		};

		idt_int_suspend: idt_int_suspend {
			/* Sleep State */
			mux {
				pins = "gpio113";
				function = "gpio";
			};

			config {
				pins = "gpio113";
				drive-strength = <2>; /* 2 MA */
				bias-pull-up;
				input-enable;
			};
		};
		power_good_active: power_good_active {
			/* Active State */
			mux {
				pins = "gpio145";
				function = "gpio";
			};
			config {
				pins = "gpio145";
				drive-strength = <2>; /* 2 MA */
				bias-pull-down;
				input-enable;
				};

		};

		power_good_suspend: power_good_suspend {
			/* Active State */
			mux {
				pins = "gpio145";
				function = "gpio";
			};
			config {
				pins = "gpio145";
				drive-strength = <2>; /* 2 MA */
				bias-pull-up;
				input-enable;
				};
		};

		reverse_booset_enable_active: reverse_booset_enable__active {
			/* Active State */
			mux {
				pins = "gpio22";
				function = "gpio";
			};

			config {
				pins = "gpio22";
				drive-strength = <16>;
				bias-pull-down;
				output-low;
			};
		};

		reverse_booset_enable_suspend: reverse_booset_enable_suspend {
			/* Sleep State */
			mux {
				pins = "gpio22";
				function = "gpio";
			};

			config {
				pins = "gpio22";
				drive-strength = <16>;
				bias-pull-down;
				output-low;
			};
		};

		txon_enable_active: txon_enable_active {
			/* Active State */
			mux {
				pins = "gpio47";
				function = "gpio";
			};

			config {
				pins = "gpio47";
				drive-strength = <16>;
				bias-disable;
				bias-pull-down;
				output-low;
			};
		};

		txon_enable_suspend: txon_enable_suspend {
			/* Sleep State */
			mux {
				pins = "gpio47";
				function = "gpio";
			};

			config {
				pins = "gpio47";
				drive-strength = <16>;
				bias-disable;
				bias-pull-down;
				output-low;
			};
		};
	};

        md_mode_ctrl_irq {
		ant1_ctrl_irq: ant1_ctrl_irq {
			mux {
				pins = "gpio111";
				function = "gpio";
			};

			config {
				pins = "gpio111";
				drive-strength = <2>;
				bias-disable;
				input-enable;
			};
		};
	};

        /* GPIO_23 : FP_INT_N */
        msm_gpio_23: msm_gpio_23 {
                mux {
                        pins = "gpio23";
                        function = "gpio";
                };

                config {
                        pins = "gpio23";
                        drive-strength = <2>;
                        bias-pull-down;
                };
        };

	/* FP_INT_N */
	msm_gpio_irq: msm_gpio_irq {
		mux {
			pins = "gpio23";
			function = "gpio";
		};

		config {
			pins = "gpio23";
			drive-strength = <2>;
			bias-pull-down;
		};
	};

	/* FP_RESET_N */
	msm_gpio_reset: msm_gpio_reset {
		mux {
			pins = "gpio125";
			function = "gpio";
		};

		config {
			pins = "gpio125";
			drive-strength = <2>;
			bias-disable;
			output-low;
		};
	};

	/* FP_RESET_N, state device active*/
	msm_gpio_reset_output_high: msm_gpio_reset_output_high {
		mux {
			pins = "gpio125";
			function = "gpio";
		};

		config {
			pins = "gpio125";
			drive-strength = <2>;
			bias-disable;
			output-high;
		};
	};

	/* Used for wire charging and otg and wirelss reverse charging features */
	ncp3902 {
		ncp3902_en_active: ncp3902_en_active {
			/* Active State */
			mux {
				/* GPIO 152 is used for NCP3092 chip to enable */
				pins = "gpio152";
				function = "gpio";
			};

			config {
				pins = "gpio152";
				bias-disable; /* No PULL */
				drive-strength = <16>; /* 16 MA */
				output-low;
			};
		};

		ncp3902_en_suspend: ncp3902_en_suspend {
			/* Sleep State */
			mux {
				pins = "gpio152";
				function = "gpio";
			};

			config {
				pins = "gpio152";
				drive-strength = <16>; /* 16 MA */
				bias-disable;
				output-low;
			};
		};
	};

	ncp3902_pass_en {
		ncp3902_pass_en_active: ncp3902_pass_en_active {
			/* Active State */
			mux {
				pins = "gpio153";
				function = "gpio";
			};

			config {
				pins = "gpio153";
				bias-disable; /* No PULL */
				drive-strength = <16>; /* 16 MA */
				output-low;
			};
		};

		ncp3902_pass_en_suspend: ncp3902_pass_en_suspend {
			/* Sleep State */
			mux {
				pins = "gpio153";
				function = "gpio";
			};

			config {
				pins = "gpio153";
				drive-strength = <16>; /* 16 MA */
				bias-disable;
				output-low;
			};
		};
	};

	pm8008_active: pm8008_active {
		mux {
			pins = "gpio76";
			function = "gpio";
		};

		config {
			pins = "gpio76";
			bias-pull-up;
			output-high;
			drive-strength = <2>;
		};
	};

	pm8008_interrupt: pm8008_interrupt {
		mux {
			pins = "gpio84";
			function = "gpio";
		};

		config {
			pins = "gpio84";
			bias-disable;
			input-enable;
		};
	};

	rx_hw_sleep_enable {
		rx_hw_en_active: rx_hw_en_active {
			/* Active State */
			config {
				pins = "gpio78";
				bias-disable; /* No PULL */
				drive-strength = <8>; /* 8 MA */
				output-high;
			};

			mux {
				/* GPIO 78 is used for hardware disable wireless rx */
				pins = "gpio78";
				function = "gpio";
			};
		};

		rx_hw_en_suspend: rx_hw_en_suspend {
			/* Sleep State */
			config {
				pins = "gpio78";
				drive-strength = <8>; /* 8 MA */
				bias-disable;
				output-low;
			};

			mux {
				pins = "gpio78";
				function = "gpio";
			};
		};
	};

	sbu_uart_en_ctrl {
		sbu_uart_en_active: uart_audio_en_active {
			mux {
				pins = "gpio159";
				function = "gpio";
			};

			config {
				pins = "gpio159";
				drive-strength = <2>;
				bias-disable;
				output-high;
			};
		};

		sbu_uart_en_idle: uart_audio_en_idle {
			mux {
				pins = "gpio159";
				function = "gpio";
			};

			config {
				pins = "gpio159";
				drive-strength = <2>;
				bias-pull-down;
				output-low;
			};
		};
	};

	test_mode_irq: test_mode_irq {
		mux {
			pins = "gpio70";
			function = "gpio";
		};

		config {
			pins = "gpio70";
			drive-strength = <2>;
			bias-pull-up;
			input-enable;
		};
	};

	ts_mux {
		ts_cs_active: ts_cs_active {
			mux {
				pins = "gpio11";
				function = "qup4";
			};

			config {
				pins = "gpio11";
				drive-strength = <6>;
				bias-disable;
			};
		};

		ts_cs_suspend: ts_cs_suspend {
			mux {
				pins = "gpio11";
				function = "gpio";
			};

			config {
				pins = "gpio11";
				drive-strength = <6>;
				bias-pull-down;
				output-low;
			};
		};
	};

	vbus_disable {
		vbus_disable_active: usb_vbus_active {
			mux {
				pins = "gpio74";
				function = "gpio";
			};

			config {
				pins = "gpio74";
				drive-strength = <2>;
				bias-pull-up;
				output-high;
			};
		};

		vbus_disable_suspend: usb_vbus_suspend {
			mux {
				pins = "gpio74";
				function = "gpio";
			};

			config {
				pins = "gpio74";
				drive-strength = <2>;
				bias-pull-down;
				output-low;
			};
		};
	};

	xiaomi_keyboard_mcu {
		xiaomi_keyboard_active: xiaomi_keyboard_active {
			mux {
				pins = "gpio155";
				function = "gpio";
			};

			config {
				pins = "gpio155";
				drive-strength = <8>;
				bias-pull-up;
			};
		};

		xiaomi_keyboard_suspend: xiaomi_keyboard_suspend {
			mux {
				pins = "gpio155";
				function = "gpio";
			};

			config {
				pins = "gpio155";
				drive-strength = <8>;
				bias-pull-down;
			};
		};
	};
};

&ts_active {
	mux {
		pins = "gpio33", "gpio39";
		function = "gpio";
	};

	config {
		pins = "gpio33", "gpio39";
		drive-strength = <8>;
		bias-pull-up;
	};
};

&ts_int_suspend {
	mux {
		pins = "gpio39";
		function = "gpio";
	};

	config {
		pins = "gpio39";
		drive-strength = <2>;
		bias-pull-down;
	};
};

&ts_reset_suspend {
	mux {
		pins = "gpio33";
		function = "gpio";
	};

	config {
		pins = "gpio33";
		drive-strength = <2>;
		bias-pull-down;
	};
};

&ufshc_mem {
	vdd-hba-supply = <&ufs_phy_gdsc>;
	vdd-hba-fixed-regulator;
	vcc-supply = <&pm8150_l17>;
	vcc-voltage-level = <2504000 2950000>;
	vcc-low-voltage-sup;
	vccq-supply = <&pm8150_l6>;
	vccq2-supply = <&pm8150_s4>;
	vcc-max-microamp = <800000>;
	vccq-max-microamp = <800000>;
	vccq2-max-microamp = <800000>;

	qcom,vddp-ref-clk-supply = <&pm8150_l6>;
	qcom,vddp-ref-clk-max-microamp = <100>;
        qcom,vccq-parent-supply = <&pm8150a_s8>;
        qcom,vccq-parent-max-microamp = <210000>;

	status = "ok";
};

&ufsphy_mem {
	compatible = "qcom,ufs-phy-qmp-v4";

	vdda-phy-supply = <&pm8150_l5>;
	vdda-phy-always-on;
	vdda-pll-supply = <&pm8150_l9>;
	vdda-phy-max-microamp = <89900>;
	vdda-pll-max-microamp = <18800>;

	status = "ok";
};

&usb_qmp_phy {
        status = "ok";
};

&usb_qmp_dp_phy {
        status = "disabled";
};

&usb0 {
        dwc3@a600000 {
                usb-phy = <&usb2_phy0>, <&usb_nop_phy>;
                maximum-speed = "high-speed";
        };
};

&usb1 {
	status = "ok";
	qcom,ignore-wakeup-src-in-hostmode;

	dwc3@a800000 {
		dr_mode = "host";
	};
};

&usb2_phy0 {
	qcom,param-override-seq =
		<0x67 0x6C
		 0x28 0x70
		 0x73 0x74>;
	qcom,global-param-override-seq =
		<0xFB 0x6C
		 0x28 0x70
		 0x73 0x74>;
};

&usb2_phy1 {
        status = "ok";
};

&vendor {
	bluetooth: bt_qca6390 {
		compatible = "qca,qca6390";
		pinctrl-names = "default";
		pinctrl-0 = <&bt_en_sleep>;
		qca,bt-reset-gpio = <&tlmm 21 0>; /* BT_EN */
                qca,bt-sw-ctrl-gpio = <&tlmm 124 0>; /* SW_CTRL */
		qca,bt-vdd-aon-supply = <&pm8150_s6>;
		qca,bt-vdd-dig-supply = <&pm8009_s2>;
		qca,bt-vdd-rfa1-supply = <&pm8150_s5>;
		qca,bt-vdd-rfa2-supply = <&pm8150a_s8>;
		qca,bt-vdd-asd-supply = <&pm8150_l16>;

		qca,bt-vdd-aon-voltage-level = <950000 950000>;
		qca,bt-vdd-dig-voltage-level = <950000 952000>;
		qca,bt-vdd-rfa1-voltage-level = <1900000 1900000>;
		qca,bt-vdd-rfa2-voltage-level = <1350000 1350000>;
		qca,bt-vdd-asd-voltage-level = <3024000 3304000>;

		qca,bt-vdd-asd-current-level = <10000>;
	};

	extcon_usb1: extcon_usb1 {
		compatible = "linux,extcon-usb-gpio";
		vbus-gpio = <&pm8150_gpios 10 GPIO_ACTIVE_HIGH>;
		id-gpio = <&tlmm 91 GPIO_ACTIVE_HIGH>;
		vbus-out-gpio = <&pm8150_gpios 9 GPIO_ACTIVE_HIGH>;

		pinctrl-names = "default";
		pinctrl-0 = <&usb2_vbus_det_default
			     &usb2_id_det_default
			     &usb2_vbus_boost_default>;
		status = "disabled";
	};
};

&vreg_hap_boost {
	status = "ok";
};

&wcd938x_codec {
	qcom,cdc-micbias1-mv = <2750>;
	qcom,cdc-micbias2-mv = <2750>;
	qcom,cdc-micbias3-mv = <2750>;
	qcom,cdc-micbias4-mv = <2750>;
};

&wdog {
	qcom,bark-time = <20000>;
	qcom,pet-time = <15000>;
};

&wil6210 {
	status = "ok";
};

&wlan {
       vdd-wlan-dig-supply = <&pm8150_s6>;
       qcom,vdd-wlan-dig-config = <950000 950000 0 0 1>;
};

&xbl_aop_mem {
	reg = <0x0 0x80600000 0x0 0x260000>;
};
